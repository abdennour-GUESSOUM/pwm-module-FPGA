/ {
	amba_pl: amba_pl {
		ranges;
		compatible = "simple-bus";
		#address-cells = <1>;
		#size-cells = <1>;
		pwm_0: pwm@43c00000 {
			xlnx,s00-axi-data-width = <32>;
			xlnx,rable = <0>;
			compatible = "xlnx,pwm-1.0";
			status = "okay";
			clock-names = "s00_axi_aclk";
			xlnx,s00-axi-addr-width = <4>;
			xlnx,ip-name = "pwm";
			xlnx,edk-iptype = "PERIPHERAL";
			reg = <0x43c00000 0x10000>;
			clocks = <&clkc 15>;
			xlnx,name = "pwm_0";
		};
	};
};
